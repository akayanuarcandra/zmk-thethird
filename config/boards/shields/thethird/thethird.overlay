/*
 * Copyright (c) 2020 The ZMK Contributors
 *
 * SPDX-License-Identifier: MIT
 */

#include <dt-bindings/zmk/matrix_transform.h>
/ {
    chosen {
        zmk,kscan = &kscan0;
        zmk,matrix-transform = &default_transform;
    };

    default_transform: keymap_transform_0 {
        compatible = "zmk,matrix-transform";
        columns = <3>;
        rows = <1>;

        map = <
            RC(0,0) RC(0,1) RC(0,2)
        >;
    };

    kscan0: kscan_0 {
        compatible = "zmk,kscan-gpio-matrix";
        wakeup-source;

        diode-direction = "col2row";

        row-gpios = <&gpio1 06 (GPIO_ACTIVE_HIGH | GPIO_PULL_DOWN)>;

        col-gpios =
                    <&gpio1 07 GPIO_ACTIVE_HIGH>,
                    <&gpio1 02 GPIO_ACTIVE_HIGH>,
                    <&gpio0 24 GPIO_ACTIVE_HIGH>;

    };
};